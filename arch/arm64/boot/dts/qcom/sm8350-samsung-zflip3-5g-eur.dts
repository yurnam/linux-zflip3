// SPDX-License-Identifier: BSD-3-Clause
/*
 * Copyright (c) 2023 Igalia S.L.
 * Authors:
 *	Nia Espera <nespera@igalia.com>
 */

/dts-v1/;

#include "sm8350-oneplus-common.dtsi"

/ {
	model = "Samsung Galaxy Z Flip3 5G";
	compatible = "samsung,b2q-eur", "qcom,sm8350";
	chassis-type = "handset";
};

